/*
 * Device Tree Source for the iWave-RZG1M-20M Qseven SOM
 *
 * Copyright (C) 2017 Renesas Electronics Corp.
 *
 * This file is licensed under the terms of the GNU General Public License
 * version 2.  This program is licensed "as is" without any warranty of any
 * kind, whether express or implied.
 */

#include "r8a7743.dtsi"
#include <dt-bindings/gpio/gpio.h>
#include "r8a7743-iwg20m.dtsi"

&qspi {
	status = "okay";

	/* WARNING - This device contains the bootloader. Handle with care. */
	flash: flash@0 {
		compatible = "sst,sst25vf016b", "jedec,spi-nor";
		spi-max-frequency = <50000000>;
	};
};

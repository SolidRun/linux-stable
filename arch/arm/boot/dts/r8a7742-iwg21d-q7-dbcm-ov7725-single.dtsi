// SPDX-License-Identifier: GPL-2.0
/*
 * This include file ties a VIN interface with a single ov7725 sensor on
 * the iWave-RZ/G1H Qseven board development platform connected with the
 * camera daughter board.
 *
 * Copyright (C) 2020 Renesas Electronics Corp.
 */

#define CAM_ENABLED	1

&CAM_PARENT_I2C {
	status = "okay";

	ov7725@21 {
		compatible = "ovti,ov7725";
		reg = <0x21>;
		clocks = <&MCLK_CAM>;
		status = "disabled";

		port {
			CAM_EP_7725: endpoint {
				bus-type = <6>;
				data-shift = <2>;
				bus-width = <8>;
				pclk-sample = <1>;
				hsync-active = <0>;
				vsync-active = <0>;
				remote-endpoint = <&VIN_EP>;
			};
		};
	};
};

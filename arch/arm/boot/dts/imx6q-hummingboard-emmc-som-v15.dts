/*
 * Copyright (C) 2014 Rabeeh Khoury (rabeeh@solid-run.com)
 * Based on dt work by Russell King
 *
 * This file is dual-licensed: you can use it either under the terms
 * of the GPL or the X11 license, at your option. Note that this dual
 * licensing only applies to this file, and not this project as a
 * whole.
 *
 *  a) This file is free software; you can redistribute it and/or
 *     modify it under the terms of the GNU General Public License
 *     version 2 as published by the Free Software Foundation.
 *
 *     This file is distributed in the hope that it will be useful,
 *     but WITHOUT ANY WARRANTY; without even the implied warranty of
 *     MERCHANTABILITY or FITNESS FOR A PARTICULAR PURPOSE.  See the
 *     GNU General Public License for more details.
 *
 * Or, alternatively,
 *
 *  b) Permission is hereby granted, free of charge, to any person
 *     obtaining a copy of this software and associated documentation
 *     files (the "Software"), to deal in the Software without
 *     restriction, including without limitation the rights to use,
 *     copy, modify, merge, publish, distribute, sublicense, and/or
 *     sell copies of the Software, and to permit persons to whom the
 *     Software is furnished to do so, subject to the following
 *     conditions:
 *
 *     The above copyright notice and this permission notice shall be
 *     included in all copies or substantial portions of the Software.
 *
 *     THE SOFTWARE IS PROVIDED "AS IS", WITHOUT WARRANTY OF ANY KIND,
 *     EXPRESS OR IMPLIED, INCLUDING BUT NOT LIMITED TO THE WARRANTIES
 *     OF MERCHANTABILITY, FITNESS FOR A PARTICULAR PURPOSE AND
 *     NONINFRINGEMENT. IN NO EVENT SHALL THE AUTHORS OR COPYRIGHT
 *     HOLDERS BE LIABLE FOR ANY CLAIM, DAMAGES OR OTHER LIABILITY,
 *     WHETHER IN AN ACTION OF CONTRACT, TORT OR OTHERWISE, ARISING
 *     FROM, OUT OF OR IN CONNECTION WITH THE SOFTWARE OR THE USE OR
 *     OTHER DEALINGS IN THE SOFTWARE.
 */
/dts-v1/;

#include "imx6q.dtsi"
#include "imx6qdl-sr-som.dtsi"
#include "imx6qdl-sr-som-ti.dtsi"
#include "imx6qdl-sr-som-emmc.dtsi"
#include "imx6qdl-hummingboard.dtsi"
#include "imx6qdl-hummingboard-vendor.dtsi"

/ {
	model = "SolidRun HummingBoard Dual/Quad (1.5som+emmc)";
	compatible = "solidrun,hummingboard/q", "fsl,imx6q";
};

&can1 {
	/* This is always disabled since the eMMC uses the canbus pins */
        status = "disabled";
};

&pinctrl_hog {
        fsl,pins = <
                /*
                 * 26 pin header GPIO description. The pins
                 * numbering as following -
                 * GPIO number | GPIO (bank,num) |  PIN number
                 * ------------+-----------------+------------
                 * gpio1       | (1,1)     | IO7
                 * gpio73      | (3,9)     | IO11
                 * gpio72      | (3,8)     | IO12
                 * gpio71      | (3,7)     | IO13
                 * gpio70      | (3,6)     | IO15
                 * NA          |           | IO16
                 * NA          |           | IO18
                 * gpio67      | (3,3)     | IO22
                 *
                 * Notice the gpioX and GPIO (Y,Z) mapping forumla :
                 * X = (Y-1) * 32 + Z
                 */
                MX6QDL_PAD_GPIO_1__GPIO1_IO01 0x400130b1
                MX6QDL_PAD_EIM_DA9__GPIO3_IO09 0x400130b1
                MX6QDL_PAD_EIM_DA8__GPIO3_IO08 0x400130b1
                MX6QDL_PAD_EIM_DA7__GPIO3_IO07 0x400130b1
                MX6QDL_PAD_EIM_DA6__GPIO3_IO06 0x400130b1
                MX6QDL_PAD_EIM_DA3__GPIO3_IO03 0x400130b1
        >;
};

&sata {
	status = "okay";
	fsl,transmit-level-mV = <1025>;
	fsl,transmit-boost-mdB = <3330>;
	fsl,transmit-atten-16ths = <9>;
	fsl,receive-eq-mdB = <3000>;
};

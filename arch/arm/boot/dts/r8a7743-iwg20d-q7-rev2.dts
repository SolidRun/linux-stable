/*
 * Device Tree Source for the iWave-RZ/G1M Qseven board
 *
 * Copyright (C) 2017 Renesas Electronics Corp.
 *
 * This file is licensed under the terms of the GNU General Public License
 * version 2.  This program is licensed "as is" without any warranty of any
 * kind, whether express or implied.
 */

/dts-v1/;
#include "r8a7743-iwg20m-rev2.dtsi"
#include "iwg20d-q7-common-rev2.dtsi"

/ {
	model = "iWave Systems RainboW-G20D-Qseven board based on RZ/G1M";
	compatible = "iwave,g20d", "iwave,g20m", "renesas,r8a7743";
};

&pciec {
	status = "okay";
};

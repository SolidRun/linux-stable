// SPDX-License-Identifier: GPL-2.0
/*
 * This include file ties a VIN interface with a single ov5640 sensor on
 * the iWave-RZ/G1H Qseven board development platform connected with the
 * camera daughter board.
 *
 * Copyright (C) 2020 Renesas Electronics Corp.
 */

#define CAM_ENABLED	1

&CAM_PARENT_I2C {
	status = "okay";

	ov5640@3c {
		compatible = "ovti,ov5640";
		reg = <0x3c>;
		clocks = <&MCLK_CAM>;
		clock-names = "xclk";
		AVDD-supply = <&reg_2p8v>;
		DOVDD-supply = <&reg_2p8v>;
		DVDD-supply = <&reg_1p8v>;
		status = "okay";

		port {
			CAM_EP_5640: endpoint {
				bus-type = <6>;
				bus-width = <8>;
				data-shift = <2>;
				pclk-sample = <1>;
				hsync-active = <0>;
				vsync-active = <0>;
				remote-endpoint = <&VIN_EP>;
			};
		};
	};
};

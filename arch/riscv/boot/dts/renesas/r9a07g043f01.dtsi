// SPDX-License-Identifier: (GPL-2.0-only OR BSD-2-Clause)
/*
 * Device Tree Source for the RZ/Five R9A07G043F01 SoC specific parts
 *
 * Copyright (C) 2022 Renesas Electronics Corp.
 */

/dts-v1/;
#include "r9a07g043f.dtsi"

/ {
	compatible = "renesas,r9a07g043f01", "renesas,r9a07g043f";
};

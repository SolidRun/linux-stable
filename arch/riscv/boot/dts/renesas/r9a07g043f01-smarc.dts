// SPDX-License-Identifier: GPL-2.0
/*
 * Device Tree Source for the RZ/Five
 *
 * Copyright (C) 2022 Renesas Electronics Corp.
 */

/dts-v1/;
#include "r9a07g043f01.dtsi"

/*
 * DIP-Switch SW1 setting
 * 1 : High; 0: Low
 * SW1-2 : SW_SD0_DEV_SEL	(1: eMMC; 0: uSD)
 * SW1-3 : SW_ET0_EN_N		(0: ETHER0; 1: CAN0,CAN1,SSI1,RSPI1)
 * Please change below MACRO's correspondingly to SW1 setting
 */

#define SW_SW0_DEV_SEL	1
#define SW_ET0_EN_N	1

#include "rzfive-smarc.dtsi"

/ {
	model = "Renesas SMARC EVK based on r9a07g043f01";
	compatible = "renesas,r9a07g043f01-smarc",
		     "renesas,r9a07g043f01",
		     "renesas,r9a07g043f";

	memory@48000000 {
		device_type = "memory";
		/* first 128MB is reserved for secure area. */
		reg = <0x0 0x48000000 0x0 0x38000000>;
	};

	reserved-memory {
		#address-cells = <2>;
		#size-cells = <2>;
		ranges;

		reserved: linux,cma@58000000 {
			compatible = "shared-dma-pool";
			no-map;
			reg = <0x0 0x58000000 0x0 0x08000000>;
		};
	};
};

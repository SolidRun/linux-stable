// SPDX-License-Identifier: (GPL-2.0-only OR BSD-2-Clause)
/*
 * Device Tree Source for the RZ/G3S R9A08G045S33 SoC specific part
 *
 * Copyright (C) 2023 Renesas Electronics Corp.
 */

/dts-v1/;

#include "r9a08g045.dtsi"

/ {
	compatible = "renesas,r9a08g045s33", "renesas,r9a08g045";
};

&soc {
	pcie: pcie@11e40000 {
		compatible = "renesas,r9a08g045s33-pcie";
		reg = <0 0x11e40000 0 0x10000>;
		ranges = <0x02000000 0 0x30000000 0 0x30000000 0 0x8000000>;
		/* Map all possible DRAM ranges (4 GB). */
		dma-ranges = <0x42000000 0 0x40000000 0 0x40000000 0x1 0x0>;
		bus-range = <0x0 0xff>;
		clocks = <&cpg CPG_MOD R9A08G045_PCI_ACLK>,
			 <&cpg CPG_MOD R9A08G045_PCI_CLKL1PM>;
		clock-names = "aclk", "pm";
		resets = <&cpg R9A08G045_PCI_ARESETN>,
			 <&cpg R9A08G045_PCI_RST_B>,
			 <&cpg R9A08G045_PCI_RST_GP_B>,
			 <&cpg R9A08G045_PCI_RST_PS_B>,
			 <&cpg R9A08G045_PCI_RST_RSM_B>,
			 <&cpg R9A08G045_PCI_RST_CFG_B>,
			 <&cpg R9A08G045_PCI_RST_LOAD_B>;
		reset-names = "aresetn", "rst_b", "rst_gp_b", "rst_ps_b",
			      "rst_rsm_b", "rst_cfg_b", "rst_load_b";
		interrupts = <GIC_SPI 395 IRQ_TYPE_LEVEL_HIGH>,
			     <GIC_SPI 396 IRQ_TYPE_LEVEL_HIGH>,
			     <GIC_SPI 397 IRQ_TYPE_LEVEL_HIGH>,
			     <GIC_SPI 398 IRQ_TYPE_LEVEL_HIGH>,
			     <GIC_SPI 399 IRQ_TYPE_LEVEL_HIGH>,
			     <GIC_SPI 400 IRQ_TYPE_LEVEL_HIGH>,
			     <GIC_SPI 401 IRQ_TYPE_LEVEL_HIGH>,
			     <GIC_SPI 402 IRQ_TYPE_LEVEL_HIGH>,
			     <GIC_SPI 403 IRQ_TYPE_LEVEL_HIGH>,
			     <GIC_SPI 404 IRQ_TYPE_LEVEL_HIGH>,
			     <GIC_SPI 405 IRQ_TYPE_LEVEL_HIGH>,
			     <GIC_SPI 406 IRQ_TYPE_LEVEL_HIGH>,
			     <GIC_SPI 407 IRQ_TYPE_LEVEL_HIGH>,
			     <GIC_SPI 408 IRQ_TYPE_LEVEL_HIGH>,
			     <GIC_SPI 409 IRQ_TYPE_LEVEL_HIGH>,
			     <GIC_SPI 410 IRQ_TYPE_LEVEL_HIGH>;
		interrupt-names = "serr", "serr_cor", "serr_nonfatal",
				  "serr_fatal", "axi_err", "inta",
				  "intb", "intc", "intd", "msi",
				  "link_bandwidth", "pm_pme", "dma",
				  "pcie_evt", "msg", "all";
		#interrupt-cells = <1>;
		interrupt-controller;
		interrupt-map-mask = <0 0 0 7>;
		interrupt-map = <0 0 0 1 &pcie 0 0 0 0>, /* INT A */
				<0 0 0 2 &pcie 0 0 0 1>, /* INT B */
				<0 0 0 3 &pcie 0 0 0 2>, /* INT C */
				<0 0 0 4 &pcie 0 0 0 3>; /* INT D */
		device_type = "pci";
		num-lanes = <1>;
		#address-cells = <3>;
		#size-cells = <2>;
		power-domains = <&cpg>;
		vendor-id = <0x1912>;
		device-id = <0x0033>;
		renesas,sysc = <&sysc>;
		status = "disabled";
	};
};

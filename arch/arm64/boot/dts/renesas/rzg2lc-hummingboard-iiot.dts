// SPDX-License-Identifier: (GPL-2.0-only OR BSD-2-Clause)
/*
* Device Tree Source for the RZ/G2L Solidrun HummingBoard Pro
*
* Copyright (C) 2023 SolidRun Ltd.
*/

/dts-v1/;
#include "rzg2lc-sr-som.dtsi"
#include "rz-hummingboard-iiot.dtsi"

/ {
	model = "Solidrun RZ/G2LC HummingBoard IIoT";
	compatible = "renesas,rzg2lc-sr-som", "renesas,r9a07g044l2", "renesas,r9a07g044";
};

&canfd {
	status = "disabled";
};
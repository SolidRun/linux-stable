// SPDX-License-Identifier: (GPL-2.0-only OR BSD-2-Clause)
/*
* Device Tree Overlay for the RZ/G2LC/G2UL Solidrun SOM eMMC
*
* Copyright (C) 2024 SolidRun Ltd.
*/


/dts-v1/;
/plugin/;

/ {
    fragment@0 {
        target = <&sdhi0>;
        __overlay__ {
            	non-removable;
                max-frequency = <50000000>;
            	fixed-emmc-driver-type = <1>;
        };
    };

    fragment@1 {
        target = <&sdhi0_dev_sel_gpio>;
        __overlay__ {
            output-high;
        };
    };
};

// SPDX-License-Identifier: GPL-2.0
/*
 * Device Tree Source for the HiHope RZ/G2M v3.0 board
 * connected with aistarvision-mipi-v2-adapter board
 *
 * Copyright (C) 2021 Renesas Electronics Corp.
 */

/dts-v1/;
#include "r8a774a3-hihope-rzg2m-ex.dts"
#include "hihope-rzg2-ex-aistarvision-mipi-adapter-2.1.dtsi"

/ {
	model = "HopeRun HiHope RZ/G2M v3.0 with sub board connected with aistarvision-mipi-v2-adapter board";
	compatible = "hoperun,hihope-rzg2m", "renesas,r8a774a3";
};

/*
 * Remove csi40 node if want to use 2 cameras
 */
&csi40 {
	status = "disabled";
};

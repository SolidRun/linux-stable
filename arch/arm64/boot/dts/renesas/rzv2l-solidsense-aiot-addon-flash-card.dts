// SPDX-License-Identifier: (GPL-2.0-only OR BSD-2-Clause)
/*
 * Option 1: SolidSense AIOT Flash Card (J6) only, no cameras.
 *
 * Apply on top of r9a07g054l2-solidsense-aiot.dtb (RZ/V2L) or
 * r9a07g044l2-solidsense-aiot.dtb (RZ/G2L).
 *
 * Copyright (C) 2026 SolidRun Ltd.
 */

/dts-v1/;
/plugin/;

#include <dt-bindings/gpio/gpio.h>
#include <dt-bindings/leds/common.h>
#include <dt-bindings/pinctrl/rzg2l-pinctrl.h>

#include "rzv2l-solidsense-aiot-flash-card.dtsi"

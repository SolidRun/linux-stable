// SPDX-License-Identifier: (GPL-2.0-only OR BSD-2-Clause)
/*
 * Device Tree Source for the RZ/V2N SolidRun Solidsense AIOT
 *
 * Copyright (C) 2025 SolidRun Ltd.
 *
 * Overlay for enabling Solidsense AIOT MIPI-CSI connector J8
 * with mipi-csi camera sony imx678 (no Flash Card).
 */

/dts-v1/;
/plugin/;

#include <dt-bindings/gpio/gpio.h>
#include <dt-bindings/pinctrl/rzg2l-pinctrl.h>

#include "rzv2n-solidsense-aiot-camera-imx678-j8.dtsi"

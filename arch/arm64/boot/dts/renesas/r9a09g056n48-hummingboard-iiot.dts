// SPDX-License-Identifier: (GPL-2.0-only OR BSD-2-Clause)
/*
 * Device Tree Source for the RZ/V2N SolidRun HummingBoard IIoT
 *
 * Copyright (C) 2025 SolidRun Ltd.
 */

/dts-v1/;

#include "rzv2n-sr-som.dtsi"
#include "rzv2n-hummingboard-iiot-common.dtsi"

/ {
	model = "Solidrun RZ/V2N HummingBoard IIoT";
	compatible = "solidrun,rzv2n-hummingboard-iiot", "solidrun,rzv2n-sr-som",
		     "renesas,r9a09g056n48", "renesas,r9a09g056";
};
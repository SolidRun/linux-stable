// SPDX-License-Identifier: (GPL-2.0-only OR BSD-2-Clause)
/*
* Device Tree Overlay for the RZ/G2LC Solidrun SOM SD
*
* Copyright (C) 2024 SolidRun Ltd.
*/

/dts-v1/;
/plugin/;

#include <dt-bindings/gpio/gpio.h>
#include <dt-bindings/pinctrl/rzg2l-pinctrl.h>

&sdhi0 {
	pinctrl-0 = <&sdhi0_pins>, <&sdhi0_cd_pins>;
	pinctrl-1 = <&sdhi0_uhs_pins>, <&sdhi0_cd_pins>;
	pinctrl-names = "default", "state_uhs";
	vmmc-supply = <&vmmc>;
	vqmmc-supply = <&reg_pmic_ldo1>;
	bus-width = <4>;
	sd-uhs-sdr50;
	sd-uhs-sdr104;
	full-pwr-cycle;
	mux-states = <&sdhi0_mux 1>;
	status = "okay";
};

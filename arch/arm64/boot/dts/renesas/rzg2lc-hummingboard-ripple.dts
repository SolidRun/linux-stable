// SPDX-License-Identifier: (GPL-2.0-only OR BSD-2-Clause)
/*
 * Copyright 2025 Josua Mayer <josua@solid-run.com>
 */

/dts-v1/;

#include "r9a07g044c2.dtsi"
#include "rzg2lc-sr-som.dtsi"
#include "rzg2lc-hummingboard-pulse-common.dtsi"
#include "rzg2lc-hummingboard-pulse-micro-hdmi.dtsi"

/ {
	model = "SolidRun RZ/G2LC HummingBoard Ripple";
	compatible = "solidrun,rzg2lc-hummingboard-ripple", "solidrun,rzg2lc-sr-som", "renesas,r9a07g044c2", "renesas,r9a07g044";
};

&pinctrl {
	pinctrl-names = "default";
	pinctrl-0 = <&mikro_int_pins>, <&mikro_rst_pins>;
};

// SPDX-License-Identifier: (GPL-2.0-only OR BSD-2-Clause)
/*
 * Device Tree Source for the RZ/G3S SMARC EVK board
 *
 * Copyright (C) 2023 Renesas Electronics Corp.
 */

/dts-v1/;

/*
 * On-board switches' states:
 * @SW_OFF: switch's state is OFF
 * @SW_ON:  switch's state is ON
 */
#define SW_OFF		0
#define SW_ON		1

/*
 * SW_CONFIG[x] switches' states:
 * @SW_CONFIG2:
 *	SW_OFF - SD0 is connected to eMMC
 *	SW_ON  - SD0 is connected to uSD0 card
 * @SW_CONFIG3:
 *	SW_OFF - SD2 is connected to SoC
 *	SW_ON  - SCIF1, SSI0, IRQ0, IRQ1 connected to SoC
 */
#define SW_CONFIG2	SW_ON
#define SW_CONFIG3	SW_ON

#include "r9a08g045s33.dtsi"
#include "rzg3s-smarc-som.dtsi"
#include "rzg3s-smarc.dtsi"

/ {
	model = "Renesas SMARC EVK version 2 based on r9a08g045s33";
	compatible = "renesas,smarc2-evk", "renesas,rzg3s-smarcm",
		     "renesas,r9a08g045s33", "renesas,r9a08g045";
};

// SPDX-License-Identifier: GPL-2.0
/*
 * Device Tree Source for the HiHope RZ/G2M v3.0 sub board
 *
 * Copyright (C) 2020 Renesas Electronics Corp.
 */

#include <dt-bindings/gpio/gpio.h>

#include "r8a774a3-hihope-rzg2m.dts"
#include "hihope-rzg2-ex.dtsi"

/ {
	model = "HopeRun HiHope RZ/G2M v3.0 with sub board";
	compatible = "hoperun,hihope-rzg2-ex", "hoperun,hihope-rzg2m",
		     "renesas,r8a774a3";
};

// SPDX-License-Identifier: (GPL-2.0+ OR MIT)
/*
 * Copyright 2025 Josua Mayer <josua@solid-run.com>
 */

/dts-v1/;

#include "r9a07g054l2.dtsi"
#include "rzg2l-sr-som.dtsi"
#include "rzg2l-hummingboard-pro.dtsi"

/ {
	model = "SolidRun RZ/V2L HummingBoard Pro";
	compatible = "solidrun,rzv2l-hummingboard-pro", "solidrun,rzv2l-sr-som", "renesas,r9a07g054l2", "renesas,r9a07g054";
};

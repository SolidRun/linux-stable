// SPDX-License-Identifier: (GPL-2.0-only OR BSD-2-Clause)
/*
 * Device Tree Source for the RZ/V2N SolidRun HummingBoard IIoT
 *
 * Copyright (C) 2025 SolidRun Ltd.
 *
 * Overlay for enabling HummingBoard IIoT on-board RS485 Port A on connector J5004.
 */

/dts-v1/;
/plugin/;

&uart2_rs_232_485_mux {
        /* select rs485 */
        idle-state = <1>;
};

&sci2 {
        linux,rs485-enabled-at-boot-time;
};

// SPDX-License-Identifier: (GPL-2.0-only OR BSD-2-Clause)
/*
 * Device Tree Source for the RZ/V2L SolidRun HummingBoard Pro
 *
 * Copyright (C) 2023 SolidRun Ltd.
 */

/dts-v1/;
#include "rzv2l-sr-som.dtsi"
#include "rz-hummingboard-common.dtsi"

/ {
	model = "Solidrun RZ/V2L HummingBoard-Pro";
	compatible = "renesas,rzv2l-sr-som", "renesas,r9a07g054l2", "renesas,r9a07g054";
};

&eth1 {
	status = "okay";
};

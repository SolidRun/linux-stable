// SPDX-License-Identifier: (GPL-2.0-only OR BSD-2-Clause)
/*
 * Device Tree Source for the RZ/V2H EVK board
 *
 * Copyright (C) 2025 Renesas Electronics Corp.
 */

/dts-v1/;
/* Switch selection settings */
#define I2C7_POEG_SEL			0
#define GPT0_CHANNEL_SEL		BOTH_CHANNEL
#define SEL_CAN01_HEADER		1
#define SEL_SCI4_CAN01			0
#define RSCI5_SEL			RSCI_UART
#define RSPI2_RSCI9_SEL			0
#define RSCI9_SEL			RSCI_UART
#define I2C2_I3C_SEL			0

#if (RSCI9_SEL != RSCI_UART && RSCI9_SEL != RSCI_I2C && RSCI9_SEL != RSCI_SPI)
#error "Cannot set mode for RSCI9"
#endif

#include "rzv2h-evk-common.dtsi"

/ {
	model = "Renesas RZ/V2H EVK Board based on r9a09g057h44";
	compatible = "renesas,rzv2h-evk", "renesas,r9a09g057h44", "renesas,r9a09g057";
};

#include "rzv2-evk-cn15-sd.dtsi"

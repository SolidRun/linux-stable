// SPDX-License-Identifier: (GPL-2.0-only OR BSD-2-Clause)
/*
 * Copyright 2025 Josua Mayer <josua@solid-run.com>
 */

#include "rzg2l-hummingboard-pulse-common.dtsi"
#include "rzg2l-hummingboard-pulse-micro-hdmi.dtsi"

/ {
	aliases {
		/delete-property/ ethernet1;
	};
};

&eth1 {
	/* this board does not use second phy / ethernet on SoM */
	status = "disabled";
};

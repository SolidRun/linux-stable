// SPDX-License-Identifier: GPL-2.0
/*
 * Device Tree Source for the Silicon Linux RZ/G2E ES1.0 evaluation kit (EK874)
 *
 * Copyright (C) 2019 Renesas Electronics Corp.
 */

#include "r8a774c0-es10-cat874.dts"
#include "cat875.dtsi"

/ {
	model = "Silicon Linux RZ/G2E ES1.0 evaluation kit EK874 (CAT874 + CAT875)";
	compatible = "si-linux,cat875", "si-linux,cat874", "renesas,r8a774c0";
};

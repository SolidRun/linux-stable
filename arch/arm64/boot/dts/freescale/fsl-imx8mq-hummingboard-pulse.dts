// SPDX-License-Identifier: (GPL-2.0 OR MIT)
//
// Device Tree file for i.MX8MQ HummingBoard Pulse
//
// Copyright 2020 Josua Mayer <josua@solid-run.com>

/dts-v1/;

#include "imx8mq-hummingboard-pulse.dts"

/ {
	model = "SolidRun i.MX8MQ HummingBoard Pulse";
};

## Documentation/devicetree/bindings/i2c/renesas,i2c-rsci.yaml
```yaml
# SPDX-License-Identifier: (GPL-2.0-only OR BSD-2-Clause)
%YAML 1.2
---
$id: http://devicetree.org/schemas/i2c/renesas,i2c-rsci.yaml#
$schema: http://devicetree.org/meta-schemas/core.yaml#

title: Renesas Serial Communication Interface (RSCI) I2C Master Controller

allOf:
  - $ref: /schemas/i2c/i2c-controller.yaml#

properties:
  compatible:
    - items:
        - enum:
            - renesas,r9a09g057-rz-rsci-i2c # RZ/V2H
            - renesas,r9a09g056-rz-rsci-i2c # RZ/V2N
        - enum:
            - renesas,rsci-i2c    # RSCI I2C mode

  reg:
    maxItems: 1

  interrupts:
    items:
        - description: Error Interrupt
        - description: Reception End Interrupt
        - description: Transmit End Interrupt
        - description: Completion Of Generation Of
                       A Start, Restart, Or Stop Condition (STI) Interrupt

  interrupt-names:
    items:
        - const: eri
        - const: rxi
        - const: txi
        - const: tei

  clock-frequency:
    description:
      Desired I2C bus clock frequency in Hz. The absence of this property
      indicates the default frequency 100 kHz.

  clocks:
    maxItems: 2

  clock-names:
    items:
      - const: fck
      - const: tclk

  resets:
    maxItems: 2

  reset-names:
    items:
      - const: presetn
      - const: tresetn

  power-domains:
    maxItems: 1

  status:
    maxItems: 1

required:
  - compatible
  - reg
  - interrupts
  - interrupt-names
  - clocks
  - clock-names
  - resets
  - reset-names
  - power-domains
  - clock-frequency
  - status

unevaluatedProperties: false

examples:
  - |
    #include <dt-bindings/interrupt-controller/arm-gic.h>
    #include <dt-bindings/clock/renesas,r9a09g056-cpg.h>
    rsci_i2c0: i2c@12800c00 {
        compatible = "renesas,r9a09g056-rz-rsci-i2c",
              "renesas,rsci-i2c";
        reg = <0 0x12800c00 0 0x400>;
        interrupts = <GIC_SPI 114 IRQ_TYPE_LEVEL_HIGH>,
              <GIC_SPI 115 IRQ_TYPE_EDGE_RISING>,
              <GIC_SPI 116 IRQ_TYPE_EDGE_RISING>,
              <GIC_SPI 117 IRQ_TYPE_LEVEL_HIGH>;
        interrupt-names = "eri", "rxi", "txi", "tei";
        clocks = <&cpg CPG_MOD 0x5d>, <&cpg CPG_MOD 0x5e>;
        clock-names = "fck", "tclk";
        power-domains = <&cpg>;
        resets = <&cpg 0x81>, <&cpg 0x82>;
        reset-names = "presetn", "tresetn";
        status = "disabled";
    };
```

## Documentation/devicetree/bindings/iio/humidity/ti,hdc3020.yaml
```yaml
# SPDX-License-Identifier: (GPL-2.0-only OR BSD-2-Clause)
%YAML 1.2
---
$id: http://devicetree.org/schemas/iio/humidity/ti,hdc3020.yaml#
$schema: http://devicetree.org/meta-schemas/core.yaml#

title: HDC3020/HDC3021/HDC3022 humidity and temperature iio sensors

maintainers:
  - Li peiyu <579lpy@gmail.com>
  - Javier Carrasco <javier.carrasco.cruz@gmail.com>

description: |
  Relative humidity and temperature sensors on I2C bus.

  Datasheet: https://www.ti.com/lit/ds/symlink/hdc3020.pdf

properties:
  compatible:
    oneOf:
      - const: ti,hdc3020
      - const: ti,hdc3021
      - const: ti,hdc3022
      - items:
          - enum:
              - ti,hdc3021
              - ti,hdc3022
          - const: ti,hdc3020

  reg:
    maxItems: 1

  vdd-supply: true

  interrupts:
    maxItems: 1

  reset-gpios:
    maxItems: 1

required:
  - compatible
  - reg
  - vdd-supply

additionalProperties: false

examples:
  - |
    #include <dt-bindings/gpio/gpio.h>
    #include <dt-bindings/interrupt-controller/irq.h>
    i2c {
        #address-cells = <1>;
        #size-cells = <0>;

        humidity@44 {
            compatible = "ti,hdc3020";
            reg = <0x44>;
            vdd-supply = <&vcc_3v3>;
            interrupt-parent = <&gpio3>;
            interrupts = <23 IRQ_TYPE_EDGE_RISING>;
            reset-gpios = <&gpio3 27 GPIO_ACTIVE_LOW>;
        };
    };
```

## Documentation/devicetree/bindings/iio/light/ti,opt4001.yaml
```yaml
# SPDX-License-Identifier: (GPL-2.0-only OR BSD-2-Clause)
%YAML 1.2
---
$id: http://devicetree.org/schemas/iio/light/ti,opt4001.yaml#
$schema: http://devicetree.org/meta-schemas/core.yaml#

title: TI OPT4001 Ambient Light Sensor

maintainers:
  - Stefan Windfeldt-Prytz <stefan.windfeldt-prytz@axis.com>

description: |
  Ambient light sensor on I2C bus with lux measurement. The two supported
  compatible strings select the packaging-specific constants used to
  calculate the lux value.

  Datasheet: https://www.ti.com/lit/gpn/opt4001

properties:
  compatible:
    enum:
      - ti,opt4001-sot-5x3
      - ti,opt4001-picostar

  reg:
    maxItems: 1

  vdd-supply: true

  interrupts:
    maxItems: 1

required:
  - compatible
  - reg
  - vdd-supply

additionalProperties: false

examples:
  - |
    #include <dt-bindings/interrupt-controller/irq.h>
    i2c {
        #address-cells = <1>;
        #size-cells = <0>;

        light-sensor@44 {
            compatible = "ti,opt4001-sot-5x3";
            reg = <0x44>;
            vdd-supply = <&vcc_3v3>;
            interrupt-parent = <&gpio3>;
            interrupts = <23 IRQ_TYPE_EDGE_FALLING>;
        };
    };
```

## Documentation/devicetree/bindings/leds/ti,lm3645.yaml
```yaml
# SPDX-License-Identifier: (GPL-2.0-only OR BSD-2-Clause)
%YAML 1.2
---
$id: http://devicetree.org/schemas/leds/ti,lm3645.yaml#
$schema: http://devicetree.org/meta-schemas/core.yaml#

title: TI LM3645 Synchronous Boost Quad LED Flash Driver

maintainers:
  - Yazan Shhady <yazan.shhady@solid-run.com>

description: |
  The LM3645 is an I2C-controlled synchronous-boost LED flash driver with
  four constant-current outputs (D1..D4), each selectable as flash, torch or
  IR. This binding describes the device as a single LED flash-class controller
  that programs and drives all four outputs together (for example an IR
  illuminator built from four IR emitters).

  Datasheet: https://www.ti.com/lit/gpn/lm3645

properties:
  compatible:
    const: ti,lm3645

  reg:
    const: 0x65

  enable-gpios:
    maxItems: 1
    description:
      GPIO connected to the HWEN (hardware enable) pin. Driven high to bring
      the device out of hardware shutdown.

  led:
    type: object
    $ref: common.yaml#
    unevaluatedProperties: false

    properties:
      function: true
      color: true
      led-max-microamp:
        description: Maximum torch current, per output.
      flash-max-microamp:
        description: Maximum flash/IR current, per output.
      flash-max-timeout-us:
        description: Maximum flash time-out (10000 to 400000 us).

required:
  - compatible
  - reg
  - led

additionalProperties: false

examples:
  - |
    #include <dt-bindings/gpio/gpio.h>
    #include <dt-bindings/leds/common.h>

    i2c {
        #address-cells = <1>;
        #size-cells = <0>;

        led-controller@65 {
            compatible = "ti,lm3645";
            reg = <0x65>;
            enable-gpios = <&gpio 2 GPIO_ACTIVE_HIGH>;

            led {
                function = LED_FUNCTION_FLASH;
                color = <LED_COLOR_ID_IR>;
                led-max-microamp = <360000>;
                flash-max-microamp = <1500000>;
                flash-max-timeout-us = <400000>;
            };
        };
    };
...
```

## Documentation/devicetree/bindings/reset/renesas,rzv2h-usbphy-ctrl.yaml
```yaml
# SPDX-License-Identifier: (GPL-2.0-only OR BSD-2-Clause)
%YAML 1.2
---
$id: http://devicetree.org/schemas/reset/renesas,rzv2h-usbphy-ctrl.yaml#
$schema: http://devicetree.org/meta-schemas/core.yaml#

title: Renesas RZ/V2H USBPHY Control

maintainers:
  - Biju Das <biju.das.jz@bp.renesas.com>

description:
  The RZ/V2H USBPHY Control mainly controls reset and power down of the
  USB/PHY.

properties:
  compatible:
    items:
      - enum:
          - renesas,r9a09g057-usbphy-ctrl # RZ/V2H
      - const: renesas,rzv2h-usbphy-ctrl

  reg:
    maxItems: 1

  clocks:
    maxItems: 1

  resets:
    maxItems: 1

  power-domains:
    maxItems: 1

  '#reset-cells':
    const: 1
    description: |
      The phandle's argument in the reset specifier is the PHY reset associated
      with the USB port.
      0 = Port 1 Phy reset
      1 = Port 2 Phy reset

required:
  - compatible
  - reg
  - clocks
  - resets
  - power-domains
  - '#reset-cells'

additionalProperties: false

examples:
  - |
        #include <dt-bindings/clock/r9a09g057-cpg.h>

        usb20phyrst: usb20phy-ctrl@15830000 {
                compatible = "renesas,r9a09g057-usbphy-ctrl",
                             "renesas,rzv2h-usbphy-ctrl";
                reg = <0 0x15830000 0 0x10000>;
                clocks = <&cpg CPG_MOD R9A09G057_USB2_PCLK_USBTST0>;
                resets = <&cpg R9A09G057_USB2_PRESETN>;
                power-domains = <&cpg>;
                #reset-cells = <1>;
        };

        usb21phyrst: usb21phy-ctrl@15840000 {
                compatible = "renesas,r9a09g057-usbphy-ctrl",
                             "renesas,rzv2h-usbphy-ctrl";
                reg = <0 0x15840000 0 0x10000>;
                clocks = <&cpg CPG_MOD R9A09G057_USB2_PCLK_USBTST1>;
                resets = <&cpg R9A09G057_USB2_PRESETN>;
                power-domains = <&cpg>;
                #reset-cells = <1>;
        };
```

## Documentation/devicetree/bindings/serial/renesas,rz-rsci.yaml
```yaml
# SPDX-License-Identifier: (GPL-2.0-only OR BSD-2-Clause)
%YAML 1.2
---
$id: http://devicetree.org/schemas/serial/renesas,rz-rsci.yaml#
$schema: http://devicetree.org/meta-schemas/core.yaml#

title: Renesas Serial Communication Interface (RSCI)

allOf:
  - $ref: serial.yaml#

properties:
  compatible:
    items:
        - enum:
            - renesas,r9a09g057-rz-rsci # RZ/V2N
            - renesas,r9a09g056-rz-rsci # RZ/V2N
        - enum:
            - renesas,rz-rsci           # RSCI UART mode
            - renesas,rz-rscif          # RSCI UART mode with FIFO

  reg:
    maxItems: 1

  interrupts:
    oneOf:
      - items:
          - description: Error Interrupt
          - description: Receive Data Full Interrupt
          - description: Transmit Data Empty Interrupt
          - description: Transmit End Interrupt

  interrupt-names:
    oneOf:
      - items:
          - const: eri
          - const: rxi
          - const: txi
          - const: tei

  clocks:
    maxItems: 2

  clock-names:
    items:
      - const: fck
      - const: tclk

  resets:
    maxItems: 2

  reset-names:
    items:
      - const: presetn
      - const: tresetn

  power-domains:
    maxItems: 1

  num-cs:
    maxItems: 1

  status:
    maxItems: 1

  uart-has-rtscts: true

required:
  - compatible
  - reg
  - interrupts
  - interrupt-names
  - clocks
  - clock-names
  - resets
  - reset-names
  - power-domains
  - status

unevaluatedProperties: false

examples:
  - |
    #include <dt-bindings/interrupt-controller/arm-gic.h>
    #include <dt-bindings/clock/renesas,r9a09g056-cpg.h>
    sci0: serial@12800c00 {
        compatible = "renesas,r9a09g056-rz-rsci", "renesas,rz-rscif";
        reg = <0 0x12800c00 0 0x400>;
        interrupts = <GIC_SPI 114 IRQ_TYPE_LEVEL_HIGH>,
              <GIC_SPI 115 IRQ_TYPE_EDGE_RISING>,
              <GIC_SPI 116 IRQ_TYPE_EDGE_RISING>,
              <GIC_SPI 117 IRQ_TYPE_LEVEL_HIGH>;
        interrupt-names = "eri", "rxi", "txi", "tei";
        clocks = <&cpg CPG_MOD 0x5d>, <&cpg CPG_MOD 0x5e>;
        clock-names = "fck", "tclk";
        power-domains = <&cpg>;
        resets = <&cpg 0x81>, <&cpg 0x82>;
        reset-names = "presetn", "tresetn";
        status = "disabled";
    };
```

## Documentation/devicetree/bindings/sound/renesas,rz-pdm.yaml
```yaml
# SPDX-License-Identifier: (GPL-2.0-only OR BSD-2-Clause)
%YAML 1.2
---
$id: http://devicetree.org/schemas/sound/renesas,rz-pdm.yaml#
$schema: http://devicetree.org/meta-schemas/core.yaml#

title: Renesas RZ ASoC Pulse Density Modulation Interface Driver (PDM)

properties:
  compatible:
    items:
      - const: renesas,rz-pdm

  reg:
    maxItems: 1

  interrupts:
    maxItems: 7

  interrupt-names:
    items:
      - const: int_pdm_err0, int_pdm_err1, int_pdm_err2
      - const: int_pdm_dat0, int_pdm_dat1, int_pdm_dat2
      - const: int_pdm_sdet

  clocks:
    maxItems: 3

  clock-names:
    items:
      - const: pdm_pclk
      - const: pdm_pclk_sfr
      - const: pdm_cclk

  power-domains:
    maxItems: 1

  resets:
    maxItems: 2

  resets-names:
    items:
      - const: pclk
      - const: cclk

  dmas:
    minItems: 1
    maxItems: 3
    description:
      The first cell represents a phandle to dmac.
      The second cell specifies DMAC REQ values of the PDM channel
      configuration connected to ICU parameters.
      bits[0:9]   - Specifies DMAC REQ value of PDM channel as below
                    DMAC REQ value of PDM0_0 rx0 = 0x0C2
                    DMAC REQ value of PDM0_1 rx1 = 0x0C3
                    DMAC REQ value of PDM0_2 rx2 = 0x0C4
                    DMAC REQ value of PDM1_0 rx0 = 0x0C5
                    DMAC REQ value of PDM1_1 rx1 = 0x0C6
                    DMAC REQ value of PDM1_2 rx2 = 0x0C7
      bit[10]     - HIEN = 1, Detects a request in response to the rising edge
                    of the signal
      bit[11]     - LVL = 1, Detects the level of a DMA request
      bits[12:14] - AM = 2, ACK bus cycle output
      bit[15]     - TM = 0, Single transfer mode
      bits[22:16] - Specifies DMAACK output number : not use define as 7F (all 1)

  dma-names:
    oneOf:
      - items:
          - const: rx0
          - const: rx1
          - const: rx2

  '#sound-dai-cells':
    const: 0

required:
  - compatible
  - reg
  - interrupts
  - interrupt-names
  - clocks
  - clock-names
  - resets
  - '#sound-dai-cells'

additionalProperties: false

examples:
  - |
    #include <dt-bindings/interrupt-controller/arm-gic.h>
    #include <dt-bindings/clock/r9a08g046-cpg.h>

	pdm: pdm@1005a000 {
		compatible = "renesas,rz-pdm";
		reg = <0 0x1005a000 0 0x400>;
		interrupts = <GIC_SPI 476 IRQ_TYPE_LEVEL_HIGH>,
			     <GIC_SPI 477 IRQ_TYPE_LEVEL_HIGH>,
			     <GIC_SPI 478 IRQ_TYPE_LEVEL_HIGH>,
			     <GIC_SPI 479 IRQ_TYPE_LEVEL_HIGH>,
			     <GIC_SPI 480 IRQ_TYPE_LEVEL_HIGH>,
			     <GIC_SPI 481 IRQ_TYPE_LEVEL_HIGH>,
			     <GIC_SPI 482 IRQ_TYPE_LEVEL_HIGH>;
		interrupt-names = "int_pdm_err0", "int_pdm_err1", "int_pdm_err2",
				  "int_pdm_dat0", "int_pdm_dat1", "int_pdm_dat2",
				  "int_pdm_sdet";
		clocks = <&cpg CPG_MOD R9A08G046_PDM_PCLK>,
			 <&cpg CPG_MOD R9A08G046_PDM_CCLK>;
		clock-names = "pdm_pclk", "pdm_cclk";
		resets = <&cpg R9A08G046_PDM_PRESETN>;
		reset-names = "pclk";
		dmas = <&dmac1 0x7F2CC2>, <&dmac1 0x7F2CC3>, <&dmac1 0x7F2CC4>;
		dma-names = "rx0", "rx1", "rx2";
		power-domains = <&cpg>;
		#sound-dai-cells = <0>;
		status = "disabled";

		channel0 {
			status = "disabled";
		};
		channel1 {
			status = "disabled";
		};
		channel2 {
			status = "disabled";
		};
	};
```

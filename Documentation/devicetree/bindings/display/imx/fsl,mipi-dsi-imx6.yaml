## Documentation/devicetree/bindings/rtc/nxp,pcf85263.txt
```
NXP PCF85263 I2C Real Time Clock

Required properties:
- compatible: must be: "nxp,rtc-pcf85263"
- reg: must be the I2C address

Optional properties:
- interrupt-names: Which interrupt signal is used must be "INTA" or "INTB"
    Defaults to "INTA"

- quartz-load-capacitance: The internal capacitor to select for the quartz:
	PCF85263_QUARTZCAP_7pF		[0]
	PCF85263_QUARTZCAP_6pF		[1]
	PCF85263_QUARTZCAP_12p5pF	[2] DEFAULT

- quartz-drive-strength: Drive strength for the quartz:
	PCF85263_QUARTZDRIVE_NORMAL	[0] DEFAULT
	PCF85263_QUARTZDRIVE_LOW	[1]
	PCF85263_QUARTZDRIVE_HIGH	[2]

- quartz-low-jitter: Boolean property, if present enables low jitter mode
which
    reduces jitter at the cost of increased power consumption.

- wakeup-source: mark the chip as a wakeup source, independently of
    the availability of an IRQ line connected to the SoC.
    This is useful if the IRQ line is connected to a PMIC or other circuit
    that can power up the device rather than to a normal SOC interrupt.

Example:

rtc@51 {
	compatible = "nxp,pcf85263";
	reg = <0x51>;

	interrupt-parent = <&gpio4>;
	interrupts = <5 IRQ_TYPE_LEVEL_LOW>;
	interrupt-names = "INTB";

	quartz-load-capacitance = <PCF85263_QUARTZCAP_12p5pF>;
	quartz-drive-strength = <PCF85263_QUARTZDRIVE_LOW>;
};
```

## Documentation/devicetree/bindings/rtc/renesas,rtca3.yaml
```yaml
# SPDX-License-Identifier: (GPL-2.0-only OR BSD-2-Clause)
%YAML 1.2
---
$id: http://devicetree.org/schemas/rtc/renesas,rtca3.yaml#
$schema: http://devicetree.org/meta-schemas/core.yaml#

title: Renesas Realtime Clock (RTCA-3)

properties:
  compatible:
    items:
      - const: renesas,rtca-3

  reg:
    maxItems: 1

  interrupts:
    maxItems: 3

  interrupt-names:
    items:
      - const: period
      - const: carry
      - const: alarm

  binary_cntmd: Option for setting counting mode
    maxItems: 1
    description: |
      Used to control count mode for RTC module. Item 0 / 1  represent
      the calendar / binary count mode. Need to use just in case binary
      count mode. Default is always 0.

required:
  - compatible
  - reg
  - interrupts
  - interrupt-names

additionalProperties: false

examples:
  - |
	#include <dt-bindings/interrupt-controller/arm-gic.h>
	#include <dt-bindings/clock/r9a08g045-cpg.h>

	rtc: rtc@1004ec00 {
		compatible = "renesas,rtca-3";
		reg = <0 0x1004ec00 0 0x400>;
		interrupts = <GIC_SPI 316 IRQ_TYPE_LEVEL_HIGH>,
			<GIC_SPI 317 IRQ_TYPE_LEVEL_HIGH>,
			<GIC_SPI 315 IRQ_TYPE_LEVEL_HIGH>;
		interrupt-names = "period", "carry", "alarm";
		binary_cntmd = <1>;
		status = "disabled";
	};
```

## Documentation/devicetree/bindings/soc/fsl/layerscape/ftm-alarm.txt
```
Freescale FlexTimer Module (FTM) Alarm

Required properties:

- compatible : Should be "fsl,ftm-alarm" or "fsl,<chip>-ftm-alarm", the
	       supported chips include
	       "fsl,ls1012a-ftm-alarm"
	       "fsl,ls1021a-ftm-alarm"
	       "fsl,ls1043a-ftm-alarm"
	       "fsl,ls1046a-ftm-alarm"
	       "fsl,ls1088a-ftm-alarm"
	       "fsl,ls208xa-ftm-alarm"
- reg : Specifies base physical address and size of the register sets for the
  FlexTimer Module and base physical address of IP Powerdown Exception Control
  Register.
- reg-names: names of the mapped memory regions listed in regs property.
  should include the following entries:
  "ftm":    Address of the register sets for FlexTimer Module
  "pmctrl": Address of IP Powerdown Exception Control register
- interrupts : Should be the FlexTimer Module interrupt.
- big-endian: If the host controller is big-endian mode, specify this property.
  The default endian mode is little-endian.

Example:
ftm0: ftm0@29d0000 {
	compatible = "fsl,ls1043a-ftm-alarm";
	reg = <0x0 0x29d0000 0x0 0x10000>,
	      <0x0 0x1ee2140 0x0 0x4>;
	reg-names = "ftm", "pmctrl";
	interrupts = <0 86 0x4>;
	big-endian;
};
```

## Documentation/devicetree/bindings/sound/renesas,rz-spdif.yaml
```yaml
# SPDX-License-Identifier: (GPL-2.0-only OR BSD-2-Clause)
%YAML 1.2
---
$id: http://devicetree.org/schemas/sound/renesas,rz-spdif.yaml#
$schema: http://devicetree.org/meta-schemas/core.yaml#

title: Renesas RZ/G3S ASoC Sony/Philips Digital Interface Format Driver (SPDIF)

properties:
  compatible:
    items:
      - enum:
          - renesas,r9a08g045-spdif  # RZ/G3S
      - const: renesas,rz-spdif

  reg:
    maxItems: 1

  interrupts:
    maxItems: 1

  interrupt-names:
    items:
      - const: intreq_spdif_n

  clocks:
    maxItems: 3

  clock-names:
    items:
      - const: spdif
      - const: audio_clk1
      - const: audio_clk2

  power-domains:
    maxItems: 1

  resets:
    maxItems: 1

  dmas:
    minItems: 1
    maxItems: 2
    description:
      The first cell represents a phandle to dmac.
      The second cell specifies the encoded MID/RID values of the SPDIF port
      connected to the DMA client and the slave channel configuration
      parameters.
      bits[0:9]   - Specifies MID/RID value of a SPDIF channel as below
                    MID/RID value of SPDIF tx = 0x279
                    MID/RID value of SPDIF rx = 0x27a
      bit[10]     - HIEN = 1, Detects a request in response to the rising edge
                    of the signal
      bit[11]     - LVL = 1, Detects based on the edge
      bits[12:14] - AM = 1, Bus cycle mode
      bit[15]     - TM = 0, Single transfer mode

  dma-names:
    oneOf:
      - items:
          - const: tx
          - const: rx

  rz,spdif-mode: Select playback or capture mode
    maxItems: 1
    description:
      Used to select mode for SPDIF module. '1' represents playback mode and
      '0' represents capture mode.

  '#sound-dai-cells':
    const: 0

required:
  - compatible
  - reg
  - interrupts
  - interrupt-names
  - clocks
  - clock-names
  - resets
  - rz,spdif-mode
  - '#sound-dai-cells'

additionalProperties: false

examples:
  - |
    #include <dt-bindings/interrupt-controller/arm-gic.h>
    #include <dt-bindings/clock/r9a08g045-cpg.h>

        spdif: spdif@100a9000 {
                compatible = "renesas,r9a08g045-spdif",
                        "renesas,rz-spdif";
                reg = <0 0x100a9000 0 0x400>;
                interrupts = <GIC_SPI 387 IRQ_TYPE_LEVEL_HIGH>;
                interrupt-names = "intreq_spdif_n";
                clocks = <&cpg CPG_MOD R9A08G045_SPDIF_PCLK>,
                        <&audio_clk1>, <&audio_clk2>;
                clock-names = "spdif-tx-rx", "audio_clk1", "audio_clk2";
                resets = <&cpg R9A08G045_SPDIF_RST>;
                dmas = <&dmac 0x1e79>, <&dmac 0x1e7a>;
                dma-names = "tx", "rx";
                power-domains = <&cpg>;
                #sound-dai-cells = <0>;
                rz,spdif-mode = <1>;
        };
```

## Documentation/devicetree/bindings/thermal/rzg3s-thermal.yaml
```yaml
# SPDX-License-Identifier: (GPL-2.0-only OR BSD-2-Clause)
%YAML 1.2
---
$id: http://devicetree.org/schemas/thermal/rzg3s-thermal.yaml#
$schema: http://devicetree.org/meta-schemas/core.yaml#

title: Renesas RZ/G3S Thermal Sensor Unit

description:
  On RZ/G3S SoCs, the thermal sensor unit (TSU) measures the
  temperature(Tj) inside the LSI.

maintainers:
  - Biju Das <biju.das.jz@bp.renesas.com>

properties:
  compatible:
    items:
      - enum:
          - renesas,r9a08g045-tsu # RZ/G3S
      - const: renesas,rzg3s-tsu

  reg:
    maxItems: 1

  clocks:
    maxItems: 1

  power-domains:
    maxItems: 1

  resets:
    maxItems: 1

  "#thermal-sensor-cells":
    const: 1

  adc-handle: ADC node to read temperature
    maxItems: 1

required:
  - compatible
  - reg
  - clocks
  - power-domains
  - resets
  - adc-handle
  - "#thermal-sensor-cells"

additionalProperties: false

examples:
  - |
    #include <dt-bindings/clock/r9a08g045-cpg.h>

    tsu: thermal@10059400 {
            compatible = "renesas,rzg3s-tsu";
            reg = <0x10059400 0x400>;
            clocks = <&cpg CPG_MOD R9A08G045_TSU_PCLK>;
            resets = <&cpg R9A08G045_TSU_PRESETN>;
            power-domains = <&cpg>;
            #thermal-sensor-cells = <1>;
            adc-handle = <&adc>;
    };

    thermal-zones {
            cpu-thermal {
                    polling-delay-passive = <250>;
                    polling-delay = <1000>;
                    thermal-sensors = <&tsu 0>;

                    trips {
                            sensor_crit: sensor-crit {
                                    temperature = <125000>;
                                    hysteresis = <1000>;
                                    type = "critical";
                            };
                    };
            };
    };
```

## Documentation/devicetree/bindings/timer/renesas,mtu3.txt
```
* Renesas Multi-Function Timer Pulse Unit 3 (MTU3)

The MTU3 is a multi-purpose, multi-channel timer/counter with configurable
clock inputs and programmable compare match.

Channels share hardware resources but their counter and compare match value
are independent. The MTU3 hardware supports nine channels indexed from 0 to 8.

Required Properties:

 - compatible: must be one or more of the following:
   - "renesas,mtu3" for MTU3 in common Renesas SoC.

 - reg: base address and length of the registers block for the timer module.

 - interrupts: interrupt specifiers for the timer, one for each entry in
   interrupt-names.

 - interrupt-names: must contain entry names following hardware manuals
   corresponding to the interrupt sources.

 - clocks: a list of phandle + clock-specifier pairs, one for each entry
   in clock-names.

 - clock-names: must contain "fck" for the functional clock.

Example 1: Add configuration for MTU3 of R9A07G044L2 (RZ/G2L) SoC.

	mtu3: timer@10001200 {
		compatible = "renesas,rzg2l-mtu3";
		reg = <0 0x10001200 0 0xB00>;
		interrupts =
			<GIC_SPI 170 IRQ_TYPE_LEVEL_HIGH>;
		interrupt-names = "tgi0a";
		clocks = <&cpg CPG_MOD R9A07G044L_CLK_MTU>;
		clock-names = "fck";
	};

Optional properties:

 - pwm_mode1: Assign pwm mode1 for each timer channel with its output pin
   and expose pwm controller through sysfs. Format is:

   pwm_mode1 = <channel output>, ..;

   Where:
	- channel is number of timer channels outputing pwm signals in pwm mode 1.
	  Channels which support pwm mode 1 are 0, 1, 2, 3, 4, 6, 7.
	- output is number of output pins. output = 0 use MTIOCA, output = 1 use MTIOCC.

 - pwm_complementary: Assign complementary pwm for each timer channel with its output pin
   and expose pwm controller through sysfs. Format is:

   pwm_complementary = <channel output>, ..;

   Where:
	- channel is number of timer channels outputing complementary pwm. Channels which
	  support complementary pwm are 3, 4, 6, 7.
	- output is number of output pins. output = 0 exports complementary pwm in
	  MTIOCA and MTIOCC pins, output = 1 means MTIOCB and MTIOCD.

Example 2: Add optional properties for pwm_mode1 (MTIOC2A) and pwm_complementary (MTIOC3B-MTIOC3D
	   and MTIOC7A-MTIOC7C).

	&mtu3 {
		pinctrl-0 = <&mtu2_pins>, <&mtu3_pins>, <&mtu7_pins>;
		pinctrl-names = "default";
		pwm_mode1 = <2 0>;
		pwm_complementary = <3 1>, <7 0>;
		status = "okay";
	};

 - 16-bit_phase_counting: Assign 16-bit A/B phase counting for MTU3 channel1 and channel2, and
   expose IIO sysfs to interact with. Use this function along with MTLCK pins setting to count
   when signals change on these pins. Format is:

   16-bit_phase_counting = <indexes of MTU3 channels>;

Example 3: Add A/B phase counters by using channel1 and channel2 of MTU3.

	&mtu3 {
		16-bit_phase_counting = <1 2>;
	};

- 32-bit_phase_counting: Assign 32-bit phase counting for both MTU3 channel1 and channel2 at a
  same time, and expose IIO sysfs to interact with. Use this function along with MTLCK pins to
  count A/B signals and MTIOC1A pin to capture Z-phase to clear counter. To enable this property,
  add below line to MTU3 node in devicetree.

  32-bit_phase_counting;

NOTE: The order of priority of MTU3's properties decides the mode will be selected,
if 1 channel is assigned for more than 1 functions at a same time.

 1. 32-bit phase counter (32-bit_phase_counting).
 2. 16-bit phase counter (16-bit_phase_counting).
 3. PWM mode 1 (pwm_mode1).
 4. Complementary PWM functions (pwm_complementary).
 5. Clocksource and clockevent (these 2 functions will be automatically supported by the smallest
    index channels which have not been assgined for any special functions).

For example: If MTU3 channel1 is set for 16-bit phase counting and pwm mode 1 at a same time,
driver will assign phase counting function for this channel.
```

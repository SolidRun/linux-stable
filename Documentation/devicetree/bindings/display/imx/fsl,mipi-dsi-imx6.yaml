## Documentation/devicetree/bindings/display/imx/fsl,mipi-dsi-imx6.yaml
```yaml
# SPDX-License-Identifier: (GPL-2.0-only OR BSD-2-Clause)
%YAML 1.2
---
$id: http://devicetree.org/schemas/display/imx/fsl,mipi-dsi-imx6.yaml#
$schema: http://devicetree.org/meta-schemas/core.yaml#

title: Freescale i.MX6 DW MIPI DSI Host Controller

maintainers:
  - Adrian Ratiu <adrian.ratiu@collabora.com>

description: |
  The i.MX6 DSI host controller is a Synopsys DesignWare MIPI DSI v1.01
  IP block with a companion PHY IP.

  These DT bindings follow the Synopsys DW MIPI DSI bindings defined in
  Documentation/devicetree/bindings/display/bridge/dw_mipi_dsi.txt with
  the following device-specific properties.

allOf:
  - $ref: ../bridge/snps,dw-mipi-dsi.yaml#

# Need a custom select here or 'snps,dw-mipi-dsi' will match lots of nodes
select:
  properties:
    compatible:
      contains:
        enum:
          - fsl,imx6-mipi-dsi
  required:
    - compatible

properties:
  '#address-cells':
    const: 1

  '#size-cells':
    const: 0

  compatible:
    items:
      - const: fsl,imx6-mipi-dsi
      - const: snps,dw-mipi-dsi

  interrupts:
    maxItems: 1

  fsl,gpr:
    description:
      Phandle to the iomuxc-gpr region containing the multiplexer ctrl register.
    $ref: /schemas/types.yaml#/definitions/phandle

unevaluatedProperties: false

required:
  - "#address-cells"
  - "#size-cells"
  - compatible
  - interrupts

examples:
  - |+
    #include <dt-bindings/clock/imx6qdl-clock.h>
    #include <dt-bindings/gpio/gpio.h>
    #include <dt-bindings/interrupt-controller/arm-gic.h>

    dsi: dsi@21e0000 {
        #address-cells = <1>;
        #size-cells = <0>;
        compatible = "fsl,imx6-mipi-dsi", "snps,dw-mipi-dsi";
        reg = <0x021e0000 0x4000>;
        interrupts = <0 102 IRQ_TYPE_LEVEL_HIGH>;
        fsl,gpr = <&gpr>;
        clocks = <&clks IMX6QDL_CLK_MIPI_CORE_CFG>,
                 <&clks IMX6QDL_CLK_MIPI_IPG>;
        clock-names = "ref", "pclk";

        ports {
            #address-cells = <1>;
            #size-cells = <0>;
            port@0 {
                reg = <0>;
                mipi_mux_0: endpoint {
                    remote-endpoint = <&ipu1_di0_mipi>;
                };
            };
            port@1 {
                reg = <1>;
                dsi_out: endpoint {
                    remote-endpoint = <&panel_in>;
                };
            };
        };

        panel@0 {
            compatible = "sharp,ls032b3sx01";
            reg = <0>;
            reset-gpios = <&gpio6 8 GPIO_ACTIVE_LOW>;
            ports {
                #address-cells = <1>;
                #size-cells = <0>;
                port@0 {
                    reg = <0>;
                    panel_in: endpoint {
                        remote-endpoint = <&dsi_out>;
                    };
                };
            };
        };
    };

...
```

## Documentation/devicetree/bindings/edac/renesas-rzg2l-edac.txt
```
Renesas RZ/G2L series and RZ/Five MPUs EDAC node

The Renesas RZ/G2L series and RZ/Five MPUs support DDR3 and DDR4 memory with and
without ECC (error correction check).

The memory controller supports SECDED (single bit error correction, double bit
error detection) effectively reducing available memory to 7/8.

Note, the bootloader must configure ECC mode in the memory controller.

Required properties:
- compatible: should be one of following strings:
	- "renesas,r9a07g044-edac"	/* RZ/G2L and RZ/G2LC */
	- "renesas,r9a07g043-edac"	/* RZ/G2UL */
	- "renesas,r9a07g043f-edac"	/* RZ/Five */
- reg: DDR controller register set should be <0 0x11410000 0 0x10000>
- interrupts: should be DDR3L/4 controller_int
- interrupt-names:  should be "ecc_irq"
- interrupt-parent: should be one of following parents:
	- <&gic>	/* RZ/G2L Series */
	- <&plic>	/* RZ/Five */

Example:
	/* RZ/G2L EDAC */
	edac: edac@11410000 {
		compatible = "renesas,r9a07g044-edac";
		reg = <0 0x11410000 0 0x10000>;
		interrupt-parent = <&gic>;
		interrupts = <GIC_SPI 40 IRQ_TYPE_LEVEL_HIGH>;
		interrupt-names = "ecc_irq";
	};
```

## Documentation/devicetree/bindings/interrupt-controller/renesas,rzg2l-irqc.txt
```
DT bindings for the RZ/G2L interrupt controller

Required properties:

- compatible: has to be "renesas,irqc-<soctype>", "renesas,rzg2l-irqc" as fallback.
- #interrupt-cells: has to be <2>: an interrupt index and flags, as defined in
  interrupts.txt in this directory.
  interrupt index for IRQ must started from 0, and index for NMI will follow IRQ index.
- clocks: Must contain a reference to the functional clock.
- resets: Must contain a reference to the functional clock.
- power-domains: Must contain a reference to a valid PM domain.
- interrupts: A list of interrupt-specifiers, one for each entry in
              interrupt-names.
- interrupt-names: A list of interrupt names which must be in below lists:
                   "irq0", "irq1", "irq2", "irq3", "irq4", "irq5", "irq6", "irq7", "nmi";
                   And must folow order IRQ first, then NMI.

Optional properties:

- any properties, listed in interrupts.txt, and any standard resource allocation
  properties

Example:
	intc_ex: interrupt-controller@0x110A0000 {
		compatible = "renesas,rzg2l-irqc";
		#interrupt-cells = <2>;
		interrupt-controller;
		reg = <0x0 0x110A0000 0 0x10000>;
		interrupts = <GIC_SPI 1 IRQ_TYPE_LEVEL_HIGH>,
				<GIC_SPI 2 IRQ_TYPE_LEVEL_HIGH>,
				<GIC_SPI 3 IRQ_TYPE_LEVEL_HIGH>,
				<GIC_SPI 4 IRQ_TYPE_LEVEL_HIGH>,
				<GIC_SPI 5 IRQ_TYPE_LEVEL_HIGH>,
				<GIC_SPI 6 IRQ_TYPE_LEVEL_HIGH>,
				<GIC_SPI 7 IRQ_TYPE_LEVEL_HIGH>,
				<GIC_SPI 8 IRQ_TYPE_LEVEL_HIGH>,
				<GIC_SPI 0 IRQ_TYPE_LEVEL_HIGH>;
		interrupt-names = "irq0", "irq1", "irq2", "irq3",
				"irq4", "irq5", "irq6", "irq7", "nmi";
		clocks = <&cpg CPG_MOD R9A07G044L_IA55_CLK>;
		resets = <&cpg R9A07G044L_IA55_RESETN >;
		power-domains = <&cpg>;
	};
```

## Documentation/devicetree/bindings/mfd/raa215300.txt
```
* Renesas RAA215300 Power Management Integrated Circuit bindings

The RAA215300 is a high-performance, low cost 9-channel PMIC designed for 32-bit
and 64-bit MCU and MPU applications. It supports DDR3, DDR3L, DDR4, and LPDDR4
memory power requirements.
The internally compensated regulators, built-in Real Time Clock (RTC), 32kHz
crystal oscillator and coin cell battery charger provide a highly integrated,
small footprint power solution ideal for System-On-Module (SoM) applications.

The RAA215300 has six high efficiency buck regulators and three LDOs to provide
the complete system power. The internal device registers and EEPROM can be used
to configure and optimize the RAA215300 for different application requirements,
for example: power sequences, output voltages, and switching frequencies.
Dynamic Voltage Scaling (DVS) and low power Sleep modes are supported.

Although the RAA215300 is an I2C slave that comes with an RTC device (same IP as
the ISL1208), the RTC IP is actually implemented as an I2C slave on its own with
its own I2C address, and its software support comes with a completely separated
driver. In order for the RTC to work properly, it has to be enabled via the PMIC
slave, and some RTC related features are also dealt with from the PMIC slave
(e.g. the RTC battery backup charger).

Required properties:
 - compatible		: Should be "renesas,raa215300".
 - reg			: I2C slave address.

Optional properties:
- rtc-enable			: Enables the RTC IP (which is disabled by default).
- charger-enable		: Example enable support battery charger
- charger-current-level		: Example property battery charger
- charger-termination-voltage	: Example property battery charger

Example:

	pmic: raa215300@12 {
		compatible = "renesas,raa215300";
		reg = <0x12>;

		rtc-enable;

		charger-enable;
		charger-current-level = <60>;
		charger-termination-voltage = <3000>;
	};
```

## Documentation/devicetree/bindings/net/marvell,10g.yaml
```yaml
# SPDX-License-Identifier: GPL-2.0-only OR BSD-2-Clause
%YAML 1.2
---
$id: http://devicetree.org/schemas/net/marvell,10g.yaml#
$schema: http://devicetree.org/meta-schemas/core.yaml#

title: Marvell Alaska X family Ethernet PHYs

maintainers:
  - Russell King <rmk+kernel@armlinux.org.uk>

allOf:
  - $ref: ethernet-phy.yaml#

properties:
  marvell,led-mode:
    description: |
      An array of one to four 16-bit integers to write to the PHY LED
      configuration registers.
    allOf:
      - $ref: /schemas/types.yaml#/definitions/uint16-array
      - minItems: 1
        maxItems: 4

examples:
  - |
    mdio {
        #address-cells = <1>;
        #size-cells = <0>;
        ethernet-phy@0 {
            reg = <0>;
            compatible = "ethernet-phy-ieee802.3-c45";
            marvell,led-mode = /bits/ 16 <0x0129 0x095d 0x0855>;
        };
    };
```

## Documentation/devicetree/bindings/pwm/renesas,gpt-rzg2l.txt
```
* Renesas GPT Timer Controller

Required Properties:
- compatible: should be "renesas,pwm-rcar" and one of the following.
 - "renesas,gpt-r9a07g044": for RZ/G2L, RZ/G2LC, RZ/V2L.

- reg: base address and length of the registers block for the PWM.
- #pwm-cells: should be 2. See pwm.txt in this directory for a description of
  the cells format.
- clocks: clock phandle and specifier pair.
- pinctrl-0: phandle, referring to a default pin configuration node.
- pinctrl-names: Set to "default".
- channel : output channel for GPT, to set this refer to output pin and
 one of the following:
	- "channel_A": use only channel A for output
	- "channel_B": use only channel B for output
	- "both_AB": use both channel A and B for output, this is double output mode


Optional properties:
- poeg: referring to a poeg node, if not set this property, GPT not
  use poeg


Example: R9A07G044L (RZ/G2L) GPT(PWM) Timer node

                gpt0: gpt@10048000 {
                        compatible = "renesas,gpt-r9a07g044";
                        reg = <0 0x10048000 0 0xa4>;
                        #pwm-cells = <2>;
                        clocks = <&cpg CPG_MOD R9A07G044_GPT_PCLK>;
                        status = "disabled";
                };

Example: GPT(PWM) node on RZ/G2L Smarc Board

                &gpt4 {
                        pinctrl-0 = <&gpt4_pins>;
                        pinctrl-names = "default";
                        channel = "both_AB";
                        poeg = <&poegd>;
                        status = "okay";
                };
```

## Documentation/devicetree/bindings/pwm/renesas,poeg-rzg2l.txt
```
* Renesas Port Output Enable for GPT (POEG)

Required Properties:
- compatible: should be "renesas,poeg" and one of the following.
 - "renesas,poeg-r9a07g044": for RZ/G2L, RZ/G2LC, RZ/V2L.
 - "renesas,poeg-r9a08g045": for RZ/G3S.

- reg: base address and length of the registers block for the POEG
- pinctrl-0: phandle, referring to a default pin configuration node.
- pinctrl-names: Set to "default".

Example: R9A07G044 (RZ/G2L) Port Output Enable for GPT (POEG)

                poega: poeg@10048800 {
                        compatible = "renesas,poeg-r9a07g044";
                        reg = <0 0x10048800 0 0x04>;
                        interrupts = <GIC_SPI 322 IRQ_TYPE_LEVEL_HIGH>;
                        status = "disabled";
                };
```

## Documentation/devicetree/bindings/pwm/renesas,rzv2m-pwm.yaml
```yaml
# SPDX-License-Identifier: (GPL-2.0-only OR BSD-2-Clause)
%YAML 1.2
---
$id: http://devicetree.org/schemas/pwm/renesas,rzv2m-pwm.yaml#
$schema: http://devicetree.org/meta-schemas/core.yaml#

title: Renesas RZ/V2{M, MA} PWM Timer (PWM)

maintainers:
  - Biju Das <biju.das.jz@bp.renesas.com>

description: |
  The RZ/V2{M, MA} PWM Timer (PWM) composed of 16 channels. It supports the
  following functions
  * The PWM has 24-bit counters which operate at PWM_CLK (48 MHz).
  * The frequency division ratio for internal counter operation is selectable
    as PWM_CLK divided by 1, 16, 256, or 2048.
  * The period as well as the duty cycle is adjustable.
  * The low-level and high-level order of the PWM signals can be inverted.
  * The duty cycle of the PWM signal is selectable in the range from 0 to 100%.
  * The minimum resolution is 20.83 ns.
  * Three interrupt sources: Rising and falling edges of the PWM signal and
    clearing of the counter
  * Counter operation and the bus interface are asynchronous and both can
    operate independently of the magnitude relationship of the respective
    clock periods.

properties:
  compatible:
    items:
      - enum:
          - renesas,r9a09g011-pwm  # RZ/V2M
          - renesas,r9a09g055-pwm  # RZ/V2MA
      - const: renesas,rzv2m-pwm

  reg:
    maxItems: 1

  '#pwm-cells':
    const: 2

  interrupts:
    maxItems: 1

  clocks:
    items:
      - description: APB clock
      - description: PWM clock

  clock-names:
    items:
      - const: apb
      - const: pwm

  power-domains:
    maxItems: 1

  resets:
    maxItems: 1

required:
  - compatible
  - reg
  - interrupts
  - clocks
  - clock-names
  - power-domains
  - resets

allOf:
  - $ref: pwm.yaml#

additionalProperties: false

examples:
  - |
    #include <dt-bindings/clock/r9a09g011-cpg.h>
    #include <dt-bindings/interrupt-controller/arm-gic.h>

    pwm8: pwm@a4010400 {
        compatible = "renesas,r9a09g011-pwm", "renesas,rzv2m-pwm";
        reg = <0xa4010400 0x80>;
        interrupts = <GIC_SPI 376 IRQ_TYPE_LEVEL_HIGH>;
        clocks = <&cpg CPG_MOD R9A09G011_CPERI_GRPF_PCLK>,
                 <&cpg CPG_MOD R9A09G011_PWM8_CLK>;
        clock-names = "apb", "pwm";
        power-domains = <&cpg>;
        resets = <&cpg R9A09G011_PWM_GPF_PRESETN>;
        #pwm-cells = <2>;
    };
```

## Documentation/devicetree/bindings/rfkill/rfkill-gpio.txt
```
GPIO controlled RFKILL devices

Required properties:
- compatible	: Must be "rfkill-gpio".
- rfkill-name	: Name of RFKILL device
- rfkill-type	: Type of RFKILL device: 1 for WiFi, 2 for BlueTooth, etc.
		  See include/uapi/linux/rfkill.h for all valid values
- reset-gpio	: reset-gpio to use
- shutdown-gpio	: Shutdown gpio to use

At least one gpio needs to be provided. If both are provided, the "reset" GPIO is toggled first.

Optional properties:
- clocks		: phandle to clock to enable/disable

Example:

	rfkill_bt {
		compatible = "rfkill-gpio";
		rfkill-name = "bluetooth";
		rfkill-type = <2>;
                reset-gpio = <&gpio7 8 GPIO_ACTIVE_HIGH>;
                shutdown-gpio = <&gpio7 9 GPIO_ACTIVE_HIGH>;
		clocks = <&clk_out_a>;
	};
```

## Documentation/devicetree/bindings/rtc/nxp,pcf8523.txt
```
NXP Semiconductors PCF8523 Real Time Clock

Required properties:
- compatible: should be: "nxp,pcf8523"
- reg: i2c address
- nxp,12p5_pf: force autodetection to start at 12.5 pf instead of 7pf

Example:

rtc: pcf8523@68 {
	compatible = "nxp,pcf8523";
	reg = <0x68>;
	nxp,12p5_pf;
};
```
